/*
 * Copyright (C) 2014 Variscite, Ltd. All Rights Reserved
 * Donio Ron: ron.d@variscite.com
 * 
 * Copyright (C) 2013 Freescale Semiconductor, Inc.
 *
 * This program is free software; you can redistribute it and/or modify
 * it under the terms of the GNU General Public License version 2 as
 * published by the Free Software Foundation.
 */

#define VAR_SOM_CAPACITIVE_DISPLAY

#include "imx6dl-var-som.dts"

